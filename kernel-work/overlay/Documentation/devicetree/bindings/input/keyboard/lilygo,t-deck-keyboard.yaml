## kernel-work/overlay/Documentation/devicetree/bindings/input/keyboard/lilygo,t-deck-keyboard.yaml
```yaml
# SPDX-License-Identifier: GPL-2.0-only OR BSD-2-Clause
%YAML 1.2
---
$id: http://devicetree.org/schemas/input/keyboard/lilygo,t-deck-keyboard.yaml#
$schema: http://devicetree.org/meta-schemas/core.yaml#

title: LilyGO T-Deck I2C keyboard

maintainers:
  - OpenAI <noreply@openai.com>

description:
  The T-Deck keyboard is scanned by a separate MCU and reports one ASCII
  character per I2C read at address 0x55.

properties:
  compatible:
    const: lilygo,t-deck-keyboard

  reg:
    const: 0x55

  poll-interval-ms:
    $ref: /schemas/types.yaml#/definitions/uint32
    minimum: 5
    maximum: 100
    default: 10

required:
  - compatible
  - reg

additionalProperties: false

examples:
  - |
    i2c {
        #address-cells = <1>;
        #size-cells = <0>;

        keyboard@55 {
            compatible = "lilygo,t-deck-keyboard";
            reg = <0x55>;
            poll-interval-ms = <10>;
        };
    };
```

## kernel-work/overlay/Documentation/devicetree/bindings/sound/espressif,esp32s3-i2s.yaml
```yaml
# SPDX-License-Identifier: (GPL-2.0-only OR BSD-2-Clause)
%YAML 1.2
---
$id: http://devicetree.org/schemas/sound/espressif,esp32s3-i2s.yaml#
$schema: http://devicetree.org/meta-schemas/core.yaml#

title: Espressif ESP32-S3 I2S controller

maintainers:
  - T-Deck Plus Linux port contributors

description: |
  The ESP32-S3 has two I2S controllers with AHB GDMA data paths. The T-Deck
  Plus uses I2S0 for MAX98357A playback and I2S1 for ES7210 four-slot TDM
  capture. GDMA descriptors must be provided from an internal-SRAM area
  reserved by the Core 0 firmware.

properties:
  compatible:
    const: espressif,esp32s3-i2s

  reg:
    maxItems: 1

  reg-names:
    items:
      - const: i2s

  interrupts:
    maxItems: 1

  clocks:
    minItems: 2
    maxItems: 2

  clock-names:
    items:
      - const: i2s
      - const: gdma

  resets:
    maxItems: 1

  reset-names:
    const: reset

  pinctrl-names:
    items:
      - const: default

  pinctrl-0:
    $ref: /schemas/types.yaml#/definitions/phandle-array

  espressif,gdma-syscon:
    $ref: /schemas/types.yaml#/definitions/phandle
    description: Phandle to the shared GDMA register block.

  espressif,rx-tdm-slots:
    const: 4
    description: Four-slot TDM receive mode used by the ES7210.

  '#sound-dai-cells':
    const: 0

required:
  - compatible
  - reg
  - interrupts
  - clocks
  - clock-names
  - resets
  - reset-names
  - espressif,gdma-syscon
  - '#sound-dai-cells'

additionalProperties: false
```

## kernel-work/overlay/Documentation/devicetree/bindings/sound/everest,es7210.yaml
```yaml
# SPDX-License-Identifier: (GPL-2.0-only OR BSD-2-Clause)
%YAML 1.2
---
$id: http://devicetree.org/schemas/sound/everest,es7210.yaml#
$schema: http://devicetree.org/meta-schemas/core.yaml#

title: Everest Semiconductor ES7210 audio ADC

maintainers:
  - T-Deck Plus Linux port contributors

description: Four-channel I2C-controlled ADC with I2S and TDM output.

allOf:
  - $ref: /schemas/sound/dai-common.yaml#

properties:
  compatible:
    const: everest,es7210

  reg:
    maxItems: 1

  '#sound-dai-cells':
    const: 0

required:
  - compatible
  - reg
  - '#sound-dai-cells'

additionalProperties: false
```
